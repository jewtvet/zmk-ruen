## dts/bindings/behaviors/zmk,behavior-conditional-key.yaml
```yaml
description: Conditional key behavior that outputs different keys based on language state

compatible: "zmk,behavior-conditional-key"

include: one-param.yaml
```

## dts/bindings/behaviors/zmk,behavior-toggle-lang.yaml
```yaml
description: Toggle language behavior for Russian/English switching

compatible: "zmk,behavior-toggle-lang"

include: one-param.yaml
```
