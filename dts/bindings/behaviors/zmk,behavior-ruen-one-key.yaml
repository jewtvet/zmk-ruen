## dts/bindings/behaviors/zmk,behavior-ruen-one-key.yaml
```yaml
description: RuEn one-key behavior

compatible: "zmk,behavior-ruen-one-key"

include: two_param.yaml

properties:
  bindings:
    type: phandles
    required: true
```

## dts/bindings/behaviors/zmk,behavior-ruen-switch.yaml
```yaml
description: RuEn lang switch behavior

compatible: "zmk,behavior-ruen-switch"

include: one_param.yaml

properties:
  bindings:
    type: phandles
    required: true
```
